/dts-v1/;

/ {
	fragment@4 {
		target = <0xffffffff>;

		__overlay__ {

			led@0 {
				compatible = "mediatek,red";
				led_mode = <0x00>;
				data = <0x01>;
				pwm_config = <0x00 0x00 0x00 0x00 0x00>;
				phandle = <0x47>;
			};

			led@1 {
				compatible = "mediatek,green";
				led_mode = <0x00>;
				data = <0x01>;
				pwm_config = <0x00 0x00 0x00 0x00 0x00>;
				phandle = <0x48>;
			};

			led@2 {
				compatible = "mediatek,blue";
				led_mode = <0x00>;
				data = <0x01>;
				pwm_config = <0x00 0x00 0x00 0x00 0x00>;
				phandle = <0x49>;
			};

			led@3 {
				compatible = "mediatek,jogball-backlight";
				led_mode = <0x00>;
				data = <0x01>;
				pwm_config = <0x00 0x00 0x00 0x00 0x00>;
				phandle = <0x4a>;
			};

			led@4 {
				compatible = "mediatek,keyboard-backlight";
				led_mode = <0x00>;
				data = <0x01>;
				pwm_config = <0x00 0x00 0x00 0x00 0x00>;
				phandle = <0x4b>;
			};

			led@5 {
				compatible = "mediatek,button-backlight";
				led_mode = <0x00>;
				data = <0x01>;
				pwm_config = <0x00 0x00 0x00 0x00 0x00>;
				phandle = <0x4c>;
			};

			led@6 {
				compatible = "mediatek,lcd-backlight";
				led_mode = <0x05>;
				data = <0x01>;
				pwm_config = <0x00 0x00 0x00 0x00 0x00>;
				phandle = <0x4d>;
			};

			vibrator@0 {
				compatible = "mediatek,vibrator";
				vib_timer = <0x19>;
				vib_limit = <0x09>;
				vib_vol = <0x0b>;
				phandle = <0x4e>;
			};

			tran_battery {
				compatible = "tran,chg_fun";
				jeita_below_t0_chg_cur = <0x00>;
				jeita_t0_to_t1_chg_cur = <0x16e360>;
				jeita_t2_to_t3_chg_cur = <0x325aa0>;
				jeita_t3_to_t4_chg_cur = <0x2625a0>;
				jeita_above_t4_chg_cur = <0x00>;
				jeita_below_t0_input_cur = <0x16e360>;
				jeita_t0_to_t1_input_cur = <0x16e360>;
				jeita_t2_to_t3_input_cur = <0x249f00>;
				jeita_t3_to_t4_input_cur = <0x2625a0>;
				jeita_above_t4_input_cur = <0xf4240>;
				phandle = <0x4f>;
			};

			swtp {
				compatible = "mediatek, swtp-eint";
				interrupt-parent = <0xffffffff>;
				interrupts = <0x03 0x08 0x03 0x00>;
				deb-gpios = <0xffffffff 0x03 0x00>;
				debounce = <0x3e800>;
				status = "okay";
				phandle = <0x50>;
			};
		};
	};

	fragment@7 {
		target = <0xffffffff>;

		__overlay__ {
			status = "okay";
			#address-cells = <0x01>;
			#size-cells = <0x00>;
			pinctrl-names = "default";
			pinctrl-0 = <0x06>;

			spislv@0 {
				compatible = "mediatek,spi_slave";
				reg = <0x00>;
				spi-max-frequency = <0x3473bc0>;
				spi-tx-bus-width = <0x01>;
				spi-rx-bus-width = <0x01>;
				low-speed-tick-delay = [04];
				low-speed-early-trans = [00];
				high-speed-tick-delay = [02];
				high-speed-early-trans = [00];
				slave-drive-strength = [03];
			};
		};
	};

	fragment@8 {
		target = <0xffffffff>;

		__overlay__ {

			spislv_mode_default {
				phandle = <0x06>;

				pins_cmd_dat {
					pinmux = <0xd02 0xf02 0x1002 0xe02>;
					drive-strength = <0x03>;
				};
			};
		};
	};

	fragment@13 {
		target = <0xffffffff>;

		__overlay__ {
			pinctrl-names = "default";
			pinctrl-0 = <0x07>;
		};
	};


	fragment@19 {
		target = <0xffffffff>;

		__overlay__ {

			lcm_rst_out1_gpio {
				phandle = <0x0e>;

				pins_cmd_dat {
					pinmux = <0x2d00>;
					slew-rate = <0x01>;
					output-high;
				};
			};

			lcm_rst_out0_gpio {
				phandle = <0x0f>;

				pins_cmd_dat {
					pinmux = <0x2d00>;
					slew-rate = <0x01>;
					output-low;
				};
			};

			lcd_bias_enp1_gpio {
				phandle = <0x10>;

				pins_cmd_dat {
					pinmux = <0xa900>;
					slew-rate = <0x01>;
					output-high;
				};
			};

			lcd_bias_enp0_gpio {
				phandle = <0x11>;

				pins_cmd_dat {
					pinmux = <0xa900>;
					slew-rate = <0x01>;
					output-low;
				};
			};

			lcd_bias_enn1_gpio {
				phandle = <0x12>;

				pins_cmd_dat {
					pinmux = <0xa500>;
					slew-rate = <0x01>;
					output-high;
				};
			};

			lcd_bias_enn0_gpio {
				phandle = <0x13>;

				pins_cmd_dat {
					pinmux = <0xa500>;
					slew-rate = <0x01>;
					output-low;
				};
			};

			lcm_dsi_te {
				phandle = <0x14>;

				pins_cmd_dat {
					pinmux = <0x2c01>;
				};
			};

			lcd_disp_pwm0_gpio {
				phandle = <0x16>;

				pins_cmd_dat {
					pinmux = <0x2b00>;
					slew-rate = <0x01>;
					output-low;
				};
			};

			lcd_disp_pwm1_gpio {
				phandle = <0x15>;

				pins_cmd_dat {
					pinmux = <0x2b00>;
					slew-rate = <0x01>;
					output-high;
				};
			};

			6382_rst_out1_gpio {
				phandle = <0x17>;

				pins_cmd_dat {
					pinmux = <0x1300>;
					slew-rate = <0x01>;
					output-high;
				};
			};

			6382_rst_out0_gpio {
				phandle = <0x18>;

				pins_cmd_dat {
					pinmux = <0x1300>;
					slew-rate = <0x01>;
					output-low;
				};
			};
		};
	};

	fragment@20 {
		target = <0xffffffff>;

		__overlay__ {
			pinctrl-names = "lcm_rst_out1_gpio", "lcm_rst_out0_gpio", "lcd_bias_enp1_gpio", "lcd_bias_enp0_gpio", "lcd_bias_enn1_gpio", "lcd_bias_enn0_gpio", "mode_te_te", "lcd_disp_pwm1_gpio", "lcd_disp_pwm0_gpio", "6382_rst_out1_gpio", "6382_rst_out0_gpio";
			pinctrl-0 = <0x0e>;
			pinctrl-1 = <0x0f>;
			pinctrl-2 = <0x10>;
			pinctrl-3 = <0x11>;
			pinctrl-4 = <0x12>;
			pinctrl-5 = <0x13>;
			pinctrl-6 = <0x14>;
			pinctrl-7 = <0x15>;
			pinctrl-8 = <0x16>;
			pinctrl-9 = <0x17>;
			pinctrl-10 = <0x18>;
			status = "okay";
		};
	};

	fragment@27 {
		target = <0xffffffff>;

		__overlay__ {

			usb_switch {
				compatible = "tran,usb_switch";
				rfc,sda8_gpio = <0xffffffff 0x70 0x00>;
				rfc,scl8_gpio = <0xffffffff 0x6e 0x00>;
				pinctrl-names = "dv2_usb_switch_gpio_init1", "dv2_usb_switch_gpio_high1", "dv2_usb_switch_gpio_low1", "dv2_rfc_sda8", "dv2_rfc_scl8", "dv2_usb_switch_gpio_init2", "dv2_usb_switch_gpio_high2", "dv2_usb_switch_gpio_low2";
				pinctrl-0 = <0x22>;
				pinctrl-1 = <0x23>;
				pinctrl-2 = <0x24>;
				pinctrl-3 = <0x25>;
				pinctrl-4 = <0x26>;
				pinctrl-5 = <0x27>;
				pinctrl-6 = <0x28>;
				pinctrl-7 = <0x29>;
				status = "okay";
				phandle = <0x52>;
			};

			pca_rfc_ta {
				compatible = "richtek,pca_rfc_ta";
				status = "okay";
				vta_step = <0x14>;
				ita_step = <0x1e>;
				ita_gap_per_vstep = <0x14>;
				pwr_lmt;
				support_meas_cap;
				support_status;
			};
		};
	};



	fragment@32 {
		target = <0xffffffff>;

		__overlay__ {

			mtk_pe50 {
				polling_interval = <0x2710>;
				ta_cv_ss_repeat_tmin = <0x19>;
				vbat_cv = <0x1176>;
				start_soc_min = <0x01>;
				start_soc_max = <0x5a>;
				start_vbat_max = <0x1144>;
				idvchg_term = <0x1f4>;
				idvchg_step = <0x32>;
				ita_level = <0xcb2 0x8ca 0x7d0 0x5dc>;
				rcable_level = <0x12c 0x190 0x1f4 0x28a>;
				ita_level_dual = <0xfa0 0xe74 0xd48 0xbb8>;
				rcable_level_dual = <0xbc 0xcb 0xdd 0xfa>;
				idvchg_ss_init = <0x4b0>;
				idvchg_ss_step = <0xfa>;
				idvchg_ss_step1 = <0x64>;
				idvchg_ss_step2 = <0x32>;
				idvchg_ss_step1_vbat = <0xfa0>;
				idvchg_ss_step2_vbat = <0x1068>;
				ta_blanking = <0x190>;
				swchg_aicr = <0x00>;
				swchg_ichg = <0x4b0>;
				swchg_aicr_ss_init = <0x190>;
				swchg_aicr_ss_step = <0xc8>;
				swchg_off_vbat = <0x109a>;
				force_ta_cv_vbat = <0x1130>;
				chg_time_max = <0x1518>;
				tta_level_def = <0x00 0x00 0x00 0x00 0x19 0x46 0x50 0x5a 0x5f>;
				tta_curlmt = <0x00 0x00 0x00 0x00 0x00 0x12c 0x258 0x384 0xffffffff>;
				tta_recovery_area = <0x03>;
				tbat_level_def = <0x0f 0x0f 0x0f 0x0f 0x19 0x29 0x2a 0x2b 0x2d>;
				tbat_curlmt = <0xffffffff 0xffffffff 0xffffffff 0x3e8 0x00 0xfa 0x2ee 0x4e2 0xffffffff>;
				tbat_recovery_area = <0x03>;
				tdvchg_level_def = <0x00 0x00 0x00 0x05 0x19 0x46 0x4b 0x50 0x55>;
				tdvchg_curlmt = <0xffffffff 0xffffffff 0xffffffff 0x12c 0x00 0x12c 0x258 0x384 0xffffffff>;
				tdvchg_recovery_area = <0x03>;
				tswchg_level_def = <0x00 0x00 0x00 0x05 0x19 0x41 0x46 0x4b 0x50>;
				tswchg_curlmt = <0xffffffff 0xffffffff 0xffffffff 0xc8 0x00 0xc8 0x12c 0x190 0xffffffff>;
				tswchg_recovery_area = <0x03>;
				ifod_threshold = <0x1c2>;
				rsw_min = <0x14>;
				ircmp_rbat = <0x05>;
				ircmp_vclamp = <0x0a>;
				vta_cap_min = <0x1a90>;
				vta_cap_max = <0x2904>;
				ita_cap_min = <0x3e8>;
				vbus_max_ovp = <0x2af8>;
				ibat_max = <0x1b58>;
				cv_reduce_step = <0x03>;
				support_ta = "pca_ta_pps", "pca_ta_rfc";
				allow_not_check_ta_status;
				rechg_ab_h = <0x29 0xffffffff 0xffffffff 0xffffffff 0xffffffff 0xffffffff 0x29>;
				rechg_ab_l = <0x0f 0xffffffff 0xffffffff 0xffffffff 0xffffffff 0xffffffff 0xffffffff>;
				dv2_ab_dev = <0x00 0x00 0x00 0x00 0x00 0x00 0x00>;
				dv2_ffc_vbat = <0x1004 0x1180 0x1180>;
				dv2_ffc_ibat = <0x9c4 0x8ca 0x8ca>;
				tpcb_level_def = <0x00 0x00 0x00 0x00 0x19 0x29 0x2a 0x2b 0x2f>;
				tpcb_curlmt = <0x00 0x00 0x00 0x00 0x00 0x1f4 0x3e8 0x5dc 0xffffffff>;
				tusb_level_def = <0x00 0x00 0x00 0x00 0x19 0x41 0x46 0x50 0x5a>;
				tusb_curlmt = <0x00 0x00 0x00 0x00 0x00 0x00 0x00 0x00 0xffffffff>;
				idvchg_pps_term = <0x4b0>;
				game_limit_ita = <0x5dc>;
			};
		};
	};

	fragment@46 {
		target = <0xffffffff>;

		__overlay__ {
			gpio_init_default = <0x00 0x00 0x00 0x00 0x01 0x01 0x01 0x01 0x00 0x00 0x00 0x00 0x01 0x01 0x02 0x00 0x00 0x00 0x01 0x00 0x01 0x03 0x00 0x00 0x00 0x01 0x01 0x00 0x04 0x00 0x00 0x00 0x01 0x01 0x01 0x05 0x00 0x00 0x00 0x01 0x00 0x00 0x06 0x00 0x00 0x00 0x01 0x01 0x01 0x07 0x00 0x00 0x00 0x01 0x01 0x00 0x08 0x00 0x00 0x00 0x01 0x01 0x00 0x09 0x00 0x00 0x00 0x01 0x00 0x00 0x0a 0x00 0x00 0x00 0x01 0x01 0x00 0x0b 0x01 0x00 0x00 0x01 0x00 0x00 0x0c 0x02 0x00 0x00 0x01 0x00 0x00 0x0d 0x02 0x00 0x00 0x01 0x00 0x00 0x0e 0x02 0x01 0x00 0x00 0x00 0x00 0x0f 0x02 0x01 0x00 0x00 0x00 0x00 0x10 0x02 0x01 0x00 0x00 0x00 0x00 0x11 0x00 0x00 0x00 0x01 0x00 0x01 0x12 0x00 0x00 0x00 0x01 0x01 0x01 0x13 0x00 0x01 0x00 0x01 0x00 0x01 0x14 0x00 0x01 0x00 0x01 0x00 0x01 0x15 0x00 0x00 0x00 0x01 0x01 0x00 0x16 0x00 0x00 0x00 0x01 0x00 0x00 0x17 0x00 0x00 0x00 0x01 0x01 0x00 0x18 0x05 0x00 0x00 0x01 0x00 0x00 0x19 0x02 0x00 0x00 0x01 0x00 0x00 0x1a 0x02 0x00 0x00 0x00 0x00 0x00 0x1b 0x02 0x01 0x00 0x00 0x00 0x00 0x1c 0x02 0x00 0x00 0x00 0x00 0x00 0x1d 0x00 0x01 0x00 0x00 0x00 0x00 0x1e 0x00 0x01 0x00 0x00 0x00 0x00 0x1f 0x00 0x00 0x00 0x01 0x00 0x00 0x20 0x01 0x00 0x00 0x01 0x00 0x00 0x21 0x01 0x01 0x00 0x00 0x00 0x00 0x22 0x01 0x01 0x00 0x00 0x00 0x00 0x23 0x01 0x01 0x00 0x00 0x00 0x00 0x24 0x00 0x01 0x01 0x00 0x00 0x00 0x25 0x02 0x01 0x00 0x00 0x00 0x00 0x26 0x00 0x00 0x00 0x00 0x00 0x01 0x27 0x00 0x00 0x00 0x01 0x01 0x01 0x28 0x02 0x00 0x00 0x01 0x00 0x00 0x29 0x00 0x00 0x00 0x01 0x01 0x01 0x2a 0x00 0x01 0x00 0x00 0x00 0x01 0x2b 0x01 0x01 0x00 0x00 0x00 0x00 0x2c 0x01 0x00 0x00 0x01 0x00 0x00 0x2d 0x00 0x01 0x00 0x00 0x00 0x00 0x2e 0x01 0x00 0x00 0x01 0x01 0x00 0x2f 0x01 0x00 0x00 0x01 0x01 0x00 0x30 0x01 0x00 0x00 0x01 0x01 0x01 0x31 0x01 0x00 0x00 0x01 0x01 0x01 0x32 0x01 0x00 0x00 0x01 0x01 0x01 0x33 0x01 0x00 0x00 0x01 0x01 0x01 0x34 0x01 0x00 0x00 0x01 0x00 0x00 0x35 0x01 0x00 0x00 0x01 0x00 0x00 0x36 0x01 0x00 0x00 0x01 0x00 0x00 0x37 0x01 0x00 0x00 0x01 0x00 0x00 0x38 0x01 0x00 0x00 0x01 0x00 0x00 0x39 0x01 0x00 0x00 0x01 0x00 0x00 0x3a 0x00 0x00 0x00 0x01 0x00 0x00 0x3b 0x01 0x00 0x00 0x01 0x00 0x00 0x3c 0x01 0x00 0x00 0x01 0x00 0x00 0x3d 0x01 0x00 0x00 0x01 0x00 0x00 0x3e 0x01 0x00 0x00 0x01 0x00 0x00 0x3f 0x01 0x00 0x00 0x01 0x00 0x00 0x40 0x01 0x00 0x00 0x01 0x00 0x00 0x41 0x01 0x00 0x00 0x01 0x00 0x00 0x42 0x01 0x00 0x00 0x01 0x00 0x00 0x43 0x01 0x00 0x00 0x01 0x00 0x00 0x44 0x01 0x00 0x00 0x01 0x00 0x00 0x45 0x01 0x00 0x00 0x01 0x00 0x00 0x46 0x01 0x00 0x00 0x01 0x00 0x00 0x47 0x01 0x00 0x00 0x01 0x00 0x00 0x48 0x01 0x00 0x00 0x01 0x00 0x00 0x49 0x01 0x00 0x00 0x01 0x00 0x00 0x4a 0x01 0x00 0x00 0x01 0x00 0x00 0x4b 0x01 0x00 0x00 0x01 0x00 0x00 0x4c 0x01 0x00 0x00 0x01 0x00 0x00 0x4d 0x01 0x00 0x00 0x01 0x00 0x00 0x4e 0x01 0x00 0x00 0x01 0x00 0x00 0x4f 0x00 0x00 0x00 0x01 0x00 0x00 0x50 0x00 0x00 0x00 0x01 0x00 0x00 0x51 0x02 0x00 0x00 0x01 0x01 0x01 0x52 0x01 0x00 0x00 0x01 0x01 0x01 0x53 0x01 0x00 0x00 0x01 0x01 0x01 0x54 0x02 0x00 0x00 0x01 0x01 0x01 0x55 0x02 0x00 0x00 0x01 0x00 0x00 0x56 0x02 0x01 0x00 0x00 0x00 0x00 0x57 0x02 0x01 0x00 0x00 0x00 0x00 0x58 0x02 0x01 0x00 0x00 0x00 0x00 0x59 0x01 0x00 0x00 0x01 0x01 0x01 0x5a 0x01 0x00 0x00 0x01 0x01 0x01 0x5b 0x00 0x00 0x00 0x00 0x00 0x00 0x5c 0x01 0x01 0x00 0x00 0x00 0x00 0x5d 0x01 0x00 0x00 0x01 0x01 0x00 0x5e 0x00 0x01 0x00 0x00 0x00 0x00 0x5f 0x01 0x00 0x00 0x01 0x01 0x00 0x60 0x01 0x01 0x00 0x00 0x00 0x00 0x61 0x00 0x00 0x00 0x01 0x01 0x00 0x62 0x00 0x00 0x00 0x01 0x00 0x00 0x63 0x01 0x01 0x00 0x00 0x00 0x00 0x64 0x01 0x01 0x00 0x00 0x00 0x00 0x65 0x00 0x01 0x00 0x00 0x00 0x00 0x66 0x00 0x01 0x00 0x00 0x00 0x00 0x67 0x01 0x00 0x00 0x01 0x01 0x01 0x68 0x01 0x00 0x00 0x01 0x01 0x01 0x69 0x01 0x00 0x00 0x01 0x01 0x01 0x6a 0x01 0x00 0x00 0x01 0x01 0x01 0x6b 0x00 0x00 0x00 0x00 0x01 0x00 0x6c 0x00 0x00 0x00 0x00 0x00 0x00 0x6d 0x00 0x01 0x00 0x00 0x00 0x00 0x6e 0x00 0x00 0x00 0x01 0x01 0x00 0x6f 0x01 0x01 0x00 0x00 0x00 0x00 0x70 0x00 0x00 0x00 0x01 0x01 0x00 0x71 0x00 0x00 0x00 0x01 0x00 0x00 0x72 0x00 0x00 0x00 0x01 0x00 0x00 0x73 0x00 0x00 0x00 0x01 0x00 0x00 0x74 0x00 0x00 0x00 0x01 0x00 0x00 0x75 0x00 0x00 0x00 0x01 0x00 0x00 0x76 0x00 0x00 0x00 0x01 0x00 0x00 0x77 0x00 0x00 0x00 0x01 0x00 0x00 0x78 0x00 0x00 0x00 0x01 0x00 0x00 0x79 0x00 0x00 0x00 0x01 0x00 0x00 0x86 0x01 0x00 0x00 0x01 0x00 0x01 0x87 0x01 0x01 0x00 0x00 0x00 0x00 0x88 0x01 0x01 0x00 0x00 0x00 0x00 0x89 0x01 0x01 0x00 0x00 0x00 0x00 0x8a 0x01 0x01 0x00 0x00 0x00 0x00 0x8b 0x01 0x01 0x00 0x00 0x00 0x00 0x8c 0x01 0x00 0x00 0x01 0x00 0x00 0x8d 0x01 0x00 0x00 0x01 0x00 0x00 0x8e 0x01 0x00 0x00 0x01 0x00 0x00 0x8f 0x01 0x00 0x00 0x01 0x00 0x00 0x90 0x01 0x00 0x00 0x01 0x00 0x00 0x91 0x01 0x01 0x00 0x00 0x00 0x00 0x92 0x01 0x01 0x00 0x00 0x00 0x00 0x93 0x01 0x01 0x00 0x00 0x00 0x00 0x94 0x01 0x01 0x00 0x00 0x00 0x00 0x95 0x01 0x01 0x00 0x00 0x00 0x00 0x96 0x00 0x01 0x00 0x00 0x00 0x00 0x97 0x00 0x01 0x00 0x00 0x00 0x00 0x98 0x00 0x01 0x00 0x00 0x00 0x00 0x99 0x00 0x01 0x00 0x00 0x00 0x00 0x9a 0x01 0x01 0x00 0x00 0x00 0x00 0x9b 0x01 0x00 0x00 0x01 0x01 0x00 0x9c 0x01 0x01 0x00 0x00 0x00 0x00 0x9d 0x01 0x01 0x00 0x00 0x00 0x00 0x9e 0x00 0x01 0x00 0x00 0x00 0x00 0x9f 0x00 0x01 0x00 0x00 0x00 0x00 0xa0 0x00 0x01 0x00 0x00 0x00 0x00 0xa1 0x01 0x00 0x00 0x01 0x01 0x01 0xa2 0x01 0x00 0x00 0x01 0x01 0x01 0xa3 0x01 0x00 0x00 0x01 0x01 0x01 0xa4 0x01 0x00 0x00 0x01 0x01 0x01 0xa5 0x00 0x01 0x00 0x00 0x00 0x00 0xa6 0x00 0x01 0x00 0x00 0x00 0x00 0xa7 0x01 0x00 0x00 0x01 0x00 0x00 0xa8 0x01 0x00 0x00 0x01 0x00 0x00 0xa9 0x00 0x01 0x00 0x00 0x00 0x00 0xaa 0x01 0x00 0x00 0x01 0x01 0x01 0xab 0x01 0x01 0x00 0x00 0x00 0x01 0xac 0x01 0x01 0x00 0x00 0x00 0x00 0xad 0x01 0x01 0x00 0x00 0x00 0x00 0xae 0x01 0x00 0x00 0x01 0x01 0x00 0xaf 0x01 0x00 0x00 0x01 0x01 0x01 0xb0 0x01 0x00 0x00 0x01 0x01 0x01 0xb2 0x00 0x01 0x00 0x00 0x00 0x00 0xb3 0x00 0x01 0x00 0x00 0x00 0x00 0xb4 0x00 0x00 0x00 0x01 0x00 0x00 0xb5 0x00 0x00 0x00 0x01 0x00 0x00 0xb6 0x00 0x00 0x00 0x01 0x00 0x00 0xb7 0x00 0x00 0x00 0x01 0x00 0x00 0xb8 0x00 0x00 0x00 0x01 0x00 0x00 0xb9 0x00 0x00 0x00 0x01 0x00 0x00 0xba 0x00 0x00 0x00 0x01 0x00 0x00>;
		};
	};


	fragment@67 {
		target = <0xffffffff>;

		__overlay__ {
			mediatek,kpd-key-debounce = <0x400>;
			mediatek,kpd-sw-pwrkey = <0x74>;
			mediatek,kpd-hw-pwrkey = <0x08>;
			mediatek,kpd-sw-rstkey = <0x73>;
			mediatek,kpd-hw-rstkey = <0x11>;
			mediatek,kpd-use-extend-type = <0x00>;
			mediatek,kpd-hw-map-num = <0x48>;
			mediatek,kpd-hw-init-map = <0x72 0x00 0x00 0x00 0x00 0x00 0x00 0x00 0x00 0x00 0x00 0x00 0x00 0x00 0x00 0x00 0x00 0x00 0x00 0x00 0x00 0x00 0x00 0x00 0x00 0x00 0x00 0x00 0x00 0x00 0x00 0x00 0x00 0x00 0x00 0x00 0x00 0x00 0x00 0x00 0x00 0x00 0x00 0x00 0x00 0x00 0x00 0x00 0x00 0x00 0x00 0x00 0x00 0x00 0x00 0x00 0x00 0x00 0x00 0x00 0x00 0x00 0x00 0x00 0x00 0x00 0x00 0x00 0x00 0x00 0x00 0x00>;
			mediatek,kpd-pwrkey-eint-gpio = <0x00>;
			mediatek,kpd-pwkey-gpio-din = <0x00>;
			mediatek,kpd-hw-dl-key0 = <0x11>;
			mediatek,kpd-hw-dl-key1 = <0x00>;
			mediatek,kpd-hw-dl-key2 = <0x08>;
			mediatek,kpd-hw-recovery-key = <0x11>;
			mediatek,kpd-hw-factory-key = <0x00>;
			status = "okay";
		};
	};


	__symbols__ {
		led0 = "/fragment@4/__overlay__/led@0";
		led1 = "/fragment@4/__overlay__/led@1";
		led2 = "/fragment@4/__overlay__/led@2";
		led3 = "/fragment@4/__overlay__/led@3";
		led4 = "/fragment@4/__overlay__/led@4";
		led5 = "/fragment@4/__overlay__/led@5";
		led6 = "/fragment@4/__overlay__/led@6";
		mtkfb_pins_lcm_rst_out1_gpio = "/fragment@19/__overlay__/lcm_rst_out1_gpio";
		mtkfb_pins_lcm_rst_out0_gpio = "/fragment@19/__overlay__/lcm_rst_out0_gpio";
	};

	__fixups__ {
		pio =
		"/fragment@8:target:0",
		"/fragment@19:target:0";
		odm = "/fragment@4:target:0", "/fragment@27:target:0", "/fragment@32:target:0";
		mtkfb = "/fragment@20:target:0";
		gpio = "/fragment@46:target:0";
		keypad = "/fragment@13:target:0", "/fragment@67:target:0";
		spi5 = "/fragment@7:target:0";
	};

	__local_fixups__ {
		fragment@20 {
			__overlay__ {
				pinctrl-0 = <0x00>;
				pinctrl-1 = <0x00>;
				pinctrl-2 = <0x00>;
				pinctrl-3 = <0x00>;
				pinctrl-4 = <0x00>;
				pinctrl-5 = <0x00>;
				pinctrl-6 = <0x00>;
				pinctrl-7 = <0x00>;
				pinctrl-8 = <0x00>;
				pinctrl-9 = <0x00>;
				pinctrl-10 = <0x00>;
			};
		};

	};
};
